## drivers/trusty/Kconfig
```kconfig
# SPDX-License-Identifier: GPL-2.0-only
#
# Trusty driver
#

menu "Trusty driver"

config TRUSTY
	tristate "Trusty core driver"
	depends on ARM || ARM64
	help
	  Trusty is a secure OS that provides a Trusted Execution Environment
	  (TEE) for Android.  Trusty runs on the same processor as Linux but is
	  isolated from the rest of the system by both hardware and software.

	  This option enables the core part of the Linux kernel driver for
	  Trusty.  This doesn't do much by itself; you'll need to enable some of
	  the sub-modules too.

	  If you build this as a module, it will be called trusty-core.

if TRUSTY

config TRUSTY_IRQ
	bool "Trusty IRQ support"
	default y
	help
	  Enable forwarding of IRQs from Linux to Trusty.  This driver retrieves
	  from Trusty a list of IRQs that Trusty uses, and it registers handlers
	  for them which notify Trusty that the IRQ has been received.

	  If you build the trusty core driver as a module, this will be part of the
	  trusty-core module.

	  Usually this is needed for Trusty to work, so say 'y'.

config TRUSTY_LOG
	tristate "Trusty log support"
	default y
	help
	  Print log messages generated by the secure OS to the Linux kernel log.

	  While this module is loaded, messages are retrieved and printed after
	  each call into Trusty, and also during Linux kernel panics.

	  If you build this as a module, it will be called trusty-log.

config TRUSTY_TEST
	tristate "Trusty stdcall test"
	default y
	help
	  Allow running tests of the Trusty stdcall interface.  Running these
	  tests is initiated by userspace writing to a sysfs file.

	  This depends on having a test sevice running on the Trusty side.

	  If you build this as a module, it will be called trusty-test.

config TRUSTY_VIRTIO
	tristate "Trusty virtio support"
	select VIRTIO
	default y
	help
	  Enable the Trusty virtio driver, which is responsible for management
	  and interaction with virtio devices exposed by Trusty.  This driver
	  requests the virtio device descriptors from Trusty, then parses them
	  and adds the corresponding virtio devices.

	  If you build this as a module, it will be called trusty-virtio.

config TRUSTY_VIRTIO_IPC
	tristate "Trusty Virtio IPC driver"
	depends on TRUSTY_VIRTIO
	default y
	help
	  Enable support for communicating with Trusty services.

	  If you build this as a module, it will be called trusty-ipc.

config TRUSTY_DMA_BUF_FFA_TAG
	bool "Availability of trusty_dma_buf_get_ffa_tag"
	default n
	help
	  Whether trusty_dma_buf_get_ffa_tag is provided on this platform.
	  Providing this function will allow the platform to select what tag
	  should be passed to the SPM when attempting to transfer the buffer
	  to secure world. The value passed here is implementation defined and
	  may depend on your SPM.

	  If set to N, a default implementation which returns 0 will be used.

config TRUSTY_DMA_BUF_SHARED_MEM_ID
	bool "Availability of trusty_dma_buf_get_shared_mem_id"
	default n
	help
	  Whether trusty_dma_buf_get_shared_mem_id is provided on this platform.
	  Providing this function allows the platform to manage memory
	  transaction life cycle of DMA bufs independently of Trusty IPC driver.
	  The latter can query trusty_shared_mem_id_t value allocated for a
	  given DMA buf using trusty_dma_buf_get_shared_mem_id interface.

	  If set to N, a default implementation which does not allocate any IDs
	  will be used.

config TRUSTY_CRASH_IS_PANIC
	bool "When trusty panics, then panic the kernel"
	help
	 This option will treat Trusty panics as fatal.  This is useful if
	 your system cannot recover from Trusty panic/halt and you require
	 the system to reboot to recover.

	 If N, it will contine to run the kernel, but trusty operations will
	 return errors.

endif # TRUSTY

endmenu
```

## drivers/video/msm/mdss/Kconfig
```kconfig
config FB_MSM_MDSS_WRITEBACK
	bool "MDSS Writeback Panel"
	---help---
	The MDSS Writeback Panel provides support for routing the output of
	MDSS frame buffer driver and MDP processing to memory.

config FB_MSM_MDSS_HDMI_PANEL
	depends on FB_MSM_MDSS
	bool "MDSS HDMI Tx Panel"
	default n
	---help---
	The MDSS HDMI Panel provides support for transmitting TMDS signals of
	MDSS frame buffer data to connected hdmi compliant TVs, monitors etc.

config HTC_MHL_DETECTION
        depends on FB_MSM_MDSS_HDMI_PANEL
        bool 'Using HTC MHL detection '
        default n
        ---help---
          Using HTC MHL detection instead of silicon image advised.

config FB_MSM_MDSS_HDMI_MHL_SII8334
	depends on FB_MSM_MDSS_HDMI_PANEL
	bool 'MHL SII8334 support '
	default n
	---help---
	  Support the HDMI to MHL conversion.
	  MHL (Mobile High-Definition Link) technology
	  uses USB connector to output HDMI content

config FB_MSM_MDSS_DSI_CTRL_STATUS
	tristate "DSI controller status check feature"
	---help---
	  Check DSI controller status periodically (default period is 5
	  seconds) by sending Bus-Turn-Around (BTA) command. If DSI controller
	  fails to acknowledge the BTA command, it sends PANEL_ALIVE=0 status
	  to HAL layer to reset the controller.

config FB_MSM_MDSS_MDP3
	depends on FB_MSM_MDSS
	bool "MDP3 display controller"
	---help---
	The MDP3 provides support for an older version display controller
	included in latest display sub-system, known as MDSS.

config FB_MSM_MDSS_HDMI_MHL_SII9234
        depends on FB_MSM_MDSS_HDMI_PANEL
        bool 'MHL SII9244 support '
        select HTC_MHL_DETECTION
        default n
        ---help---
          Support the HDMI to MHL conversion.
          MHL (Mobile High-Definition Link) technology
          uses USB connector to output HDMI content
          Only support detect MHL dongle by USB driver in SII9234.

config FB_MSM_MDSS_HDMI_MHL_SII8240_SII8558
        depends on FB_MSM_MDSS_HDMI_PANEL
        bool 'MHL SII8240/SII8558 support '
        default n
        ---help---
          Support the HDMI to MHL conversion.
          MHL (Mobile High-Definition Link) technology
          uses USB connector to output HDMI content

config INTERNAL_CHARGING_SUPPORT
        depends on FB_MSM_MDSS_HDMI_PANEL
        boolean "INTERNAL CHARGING SUPPORT"
        default n:

config MHL_DONGLE_WORKAROUND
    depends on FB_MSM_MDSS_HDMI_PANEL
	boolean 'Dongle MHL function workaround'
	default n
	---help---
	Support the MHL function in some dongle.
	Some dongle will abort cbus command when it's reading devcap.
	Workaound for this kind of issue.

config MHL_MONITOR_WORKAROUND
	depends on INTERNAL_CHARGING_SUPPORT
	boolean 'Monitor MHL function workaround'
	default n
	---help---
	Support the MHL function in some monitor.
	Some monitor can't full support HDMI spec.
	Workaound for this kind of issue
```

## lib/vdso/Kconfig
```kconfig
# SPDX-License-Identifier: GPL-2.0

config HAVE_GENERIC_VDSO
	bool

config GENERIC_GETTIMEOFDAY
	bool
	depends on HAVE_GENERIC_VDSO || ARM
	help
	  This is a generic implementation of gettimeofday vdso.
	  Each architecture that enables this feature has to
	  provide the fallback implementation.

if HAVE_GENERIC_VDSO

config GENERIC_VDSO_32
	bool
	depends on GENERIC_GETTIMEOFDAY && !64BIT
	help
	  This config option helps to avoid possible performance issues
	  in 32 bit only architectures.

config GENERIC_COMPAT_VDSO
	bool
	help
	  This config option enables the compat VDSO layer.

endif
```

## security/rootfctrl/Kconfig
```kconfig
config SECURITY_ROOTFCTRL
	bool "HTC Root File Control Support"
	depends on SECURITY
    select SECURITY_PATH
	default n
	help
	  This selects HTC root file control mechanism.
	  If you are unsure how to answer this question, answer N.
```
