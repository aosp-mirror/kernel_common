## Documentation/devicetree/bindings/cpufreq/cpufreq-virtual-kvm.yaml
```yaml
# SPDX-License-Identifier: GPL-2.0-only OR BSD-2-Clause
%YAML 1.2
---
$id: http://devicetree.org/schemas/cpufreq/cpufreq-virtual-kvm.yaml#
$schema: http://devicetree.org/meta-schemas/core.yaml#

title: Virtual KVM CPUFreq

maintainers:
  - David Dai <davidai@google.com>

description: |

  KVM CPUFreq is a virtualized driver in guest kernels that sends utilization
  of its vCPUs as a hint to the host. The host uses hint to schedule vCPU
  threads and select CPU frequency. It enables accurate Per-Entity Load
  Tracking for tasks running in the guest by querying host CPU frequency
  unless a virtualized FIE exists(Like AMUs).

properties:
  compatible:
    const: virtual,kvm-cpufreq

required:
  - compatible

additionalProperties: false

examples:
  - |
    {
      #address-cells = <2>;
      #size-cells = <2>;

      cpufreq {
            compatible = "virtual,kvm-cpufreq";
      };

    };
```

## Documentation/devicetree/bindings/usb/typec-switch.yaml
```yaml
# SPDX-License-Identifier: (GPL-2.0-only OR BSD-2-Clause)
%YAML 1.2
---
$id: http://devicetree.org/schemas/usb/typec-switch.yaml#
$schema: http://devicetree.org/meta-schemas/core.yaml#

title: USB Type-C Switch

maintainers:
  - Prashant Malani <pmalani@chromium.org>

description:
  A USB Type-C switch represents a component which routes USB Type-C data
  lines to various protocol host controllers (e.g USB, VESA DisplayPort,
  Thunderbolt etc.) depending on which mode the Type-C port, port partner
  and cable are operating in. It can also modify lane routing based on
  the orientation of a connected Type-C peripheral.

properties:
  compatible:
    const: typec-switch

  mode-switch:
    type: boolean
    description: Specify that this switch can handle alternate mode switching.

  orientation-switch:
    type: boolean
    description: Specify that this switch can handle orientation switching.

  ports:
    $ref: /schemas/graph.yaml#/properties/ports
    description: OF graph binding modelling data lines to the Type-C switch.

    properties:
      port@0:
        $ref: /schemas/graph.yaml#/properties/port
        description: Link between the switch and a Type-C connector.

    required:
      - port@0

required:
  - compatible
  - ports

anyOf:
  - required:
      - mode-switch
  - required:
      - orientation-switch

additionalProperties: true

examples:
  - |
    drm-bridge {
        usb-switch {
            compatible = "typec-switch";
            mode-switch;
            orientation-switch;
            ports {
                #address-cells = <1>;
                #size-cells = <0>;

                port@0 {
                    reg = <0>;
                    anx_ep: endpoint {
                        remote-endpoint = <&typec_controller>;
                    };
                };
            };
        };
    };
```

## Documentation/devicetree/bindings/uwb/nxp,uwb-sr1xx.yaml
```yaml
# SPDX-License-Identifier: (GPL-2.0 OR BSD-2-Clause)

%YAML 1.2
---
$id: http://devicetree.org/schemas/uwb/nxp,uwb-sr1xx.yaml#
$schema: http://devicetree.org/meta-schemas/core.yaml#

title:  NXP SR1XX SOC family of Ultra Wide Band(UWB) device bindings

description: The nxp-sr1xx driver works for the NXP SR1XX series of Ultra Wide
    Band devices namely, SR150 and SR100T devices, and uses UWB Controller Interface (UCI).
    The corresponding details are available in the FiRa Consortium Website.
    (https://www.firaconsortium.org/). More details on the SR1XX Family can be
    found at https://www.nxp.com/products/:UWB-TRIMENSION

maintainers:
  - Manjunatha Venkatesh <manjunatha.venkatesh@nxp.com>

properties:
  compatible:
    enum:
      - nxp,sr1xx

  reg:
    maxItems: 1

  spi-max-frequency:
    maximum: 45000000

required:
  - compatible
  - reg
  - spi-max-frequency

additionalProperties: false

examples:
  - |
    /* for Raspberry Pi with pin control stuff for GPIO irq */
    #include <dt-bindings/interrupt-controller/irq.h>
    #include <dt-bindings/gpio/gpio.h>

    fragment@1 {
        target = <&spi0>;
        spi {
            /* needed to avoid dtc warning */
            #address-cells = <1>;
            #size-cells = <0>;
            interrupts = <GIC_SPI 116 IRQ_TYPE_LEVEL_HIGH>;
            status = "enabled";

            sr1xx: sr1xx@0 {
                compatible = "nxp,sr1xx";
                reg = <0>;    /* CE0 */
                /* GPIO_24 (PIN 18) Host Irq*/
                nxp,sr1xx-irq-gpios = <&gpio 24 0>;
                /* GPIO_18(PIN 12) Chip Enable*/
                nxp,sr1xx-ce-gpios = <&gpio 18 0>;
                /* GPIO_23(PIN 16) Read Indication from Host to SR1xx*/
                nxp,sr1xx-ri-gpios = <&gpio 23 0>;
                /*max supported frequency */
                spi-max-frequency = <20000000>;
            };
        };
    };
```

## arch/arm/Kconfig.htc
```kconfig
comment "HTC Debugging Features"
menuconfig HTC_DEBUG
	bool "HTC Debugging Feature Switch"
	default n
	help
	  Enable collection of debug features.
	  This feature is enabled in defconfig.

config HTC_DEBUG_WORKQUEUE
	bool "HTC style workqueue debug features"
	depends on HTC_DEBUG
	help
	  Say Y here if you want the HTC style workqueue debug features

config HTC_DEBUG_WATCHDOG
	bool "HTC style watchdog debug features"
	depends on HTC_DEBUG && MSM_WATCHDOG_V2
	help
	  Say Y here if you want the HTC style watchdog debug features

config HTC_DEBUG_RTB
	bool "HTC style rtb debug features"
	depends on HTC_DEBUG && MSM_RTB
	help
	  Say Y here if you want the HTC style rtb debug features

config HTC_DEBUG_SSR
	bool "HTC style subsys restart debug features"
	depends on HTC_DEBUG && MSM_SUBSYSTEM_RESTART
	help
	  Say Y here if you want the HTC style subsys restart debug features

config HTC_DEBUG_KP
	bool "HTC style kernel panic debug features"
	depends on HTC_DEBUG
	help
	  Say Y here if you want the HTC style kernel panic debug features

config HTC_DEBUG_CACHE
	bool "HTC style processor cache debug features"
	depends on HTC_DEBUG
	help
	  Say Y here if you want the HTC style processor cache debug features

config HTC_DEBUG_VMALLOC_DUMP
	bool "HTC style vmalloc fail debug features"
	depends on HTC_DEBUG
	default y
	help
	  This option enables the dump for vmalloc info when vmalloc failed.
	  The same information could also be get under /proc/vmallocinfo

config HTC_DEBUG_DSP
	bool "HTC debug feature for trigger ramdump whne lpass related timeout"
	depends on HTC_DEBUG
	default n
	help
	  This option enables the trigger ramdump when lpass command timeout.

config HTC_DEBUG_RAMCONSOLE
	bool "HTC style ram console debug features"
	depends on ANDROID_RAM_CONSOLE
	help
	  Say Y here if you want the HTC style ram console debug features

config HTC_DEBUG_BINDER_WRITE
        bool "HTC debug feature for system_server binder write"
        depends on HTC_DEBUG
        help
          Say Y here if you want the HTC debug feature for system_server binder
          write

config HTC_DEBUG_SEND_SIGNAL
        bool "HTC debug feature for send_signal debug support"
        depends on HTC_DEBUG
        help
          This option enables kernel debug log and dump_stack
          if any processes send signal to assigned processes

config HTC_DEBUG_DYING_PROCS
        bool "HTC debug feature for recording dying processes"
        depends on HTC_DEBUG
        help
          This option enables the recording of latest 10 killed processes in
          /proc/dying_processes

comment "HTC features"
menuconfig HTC_FEATURES
        bool "HTC Implement Features"
        default n
        help
          Enable collection of HTC features.
          This feature is enabled in defconfig.

config HTC_FEATURES_FINAL_EFS_SYNC
	bool "Final EFS SYNC"
	depends on HTC_FEATURES
	default n
	help
	  Enable the trigger of final efs sync before shutdown/reboot
	  This feature is enabled in defconfig.

config HTC_FEATURES_SSR
       bool "HTC style ssr features"
       depends on HTC_FEATURES && MSM_SUBSYSTEM_RESTART
       default n
       help
         Say Y here if you want the HTC style ssr features

config HTC_FEATURES_SSR_MODEM_ENABLE
       bool "HTC style modem ssr features"
       depends on HTC_FEATURES_SSR
       default n
       help
         Say Y here if you want the HTC style for modem ssr features

config HTC_FEATURES_SSR_LPASS_ENABLE
       bool "HTC style lpass ssr features"
       depends on HTC_FEATURES_SSR
       default n
       help
         Say Y here if you want the HTC style for lpass ssr features

config HTC_FEATURES_SSR_WCNSS_ENABLE
       bool "HTC style wcnss ssr features"
       depends on HTC_FEATURES_SSR
       default n
       help

config HTC_DEBUG_FOOTPRINT
       bool "Record footprint on some actions"
       default n
       depends on HTC_DEBUG
       help
         Record footprints for debug tracking.
         Especially for suspend/resume and boot.

config HTC_DEFAULT_ENABLED_FEATURES
	bool "Select default enabled config for HTC projects"
	default y
	select COMPACTION
	help
	  Default y to select other configs which should be enabled by default
	  for HTC projects.

config HTC_BUILD_EDIAG
        bool "Build in embedded diag fixes"
        default n
        help
          For embedded diag we need to do some additional fixes.

config ENLARGE_RADIO_BUFFER
        bool "Enlarge radio buffer"
        default n
        help
          Enlarge radio buffer for two rild project.

config HTC_RPM_CMD
	bool "HTC homebrew command interface"
	depends on MSM_RPM || MSM_RPM_SMD
	default n
	help
	  This expose HTC RPM command interface for different purpose.

config HTC_POWER_HACK
       bool "HTC POWER HACK"
       help
         Say Y here if HTC POWER HACK

config HTC_DEBUG_RIL_PCN0005_HTC_DUMP_SMSM_LOG
	tristate "HTC_DEBUG_RIL_PCN0005_HTC_DUMP_SMSM_LOG"
	default n
	depends on MSM_SMD
	---help---
	  Dump SMSM log message

config HTC_DEBUG_RIL_PCN0006_HTC_DUMP_BAM_DMUX_LOG
	tristate "HTC_DEBUG_RIL_PCN0006_HTC_DUMP_BAM_DMUX_LOG"
	default n
	depends on MSM_BAM_DMUX
	---help---
	  Dump BAM DMUX log message
```
