## drivers/media/platform/msm/camera_v2/Kconfig
```kconfig
config MSM_CAMERA_SENSOR
	    bool "Qualcomm MSM camera sensor support"
	    depends on MSMB_CAMERA
        ---help---
          This flag enables support for Camera Sensor.
          The sensor driver is capable of providing real time
          data for camera support. The driver support V4L2
          subdev APIs.

config MSM_CPP
        bool "Qualcomm MSM Camera Post Processing Engine support"
        depends on MSMB_CAMERA
        ---help---
          Enable support for Camera Post-processing Engine
          The Post processing engine is capable of scaling
          and cropping image. The driver support V4L2 subdev
          APIs.

config MSM_CCI
        bool "Qualcomm MSM Camera Control Interface support"
        depends on MSMB_CAMERA
        ---help---
          Enable support for Camera Control Interface driver only
          for those platforms that have hardware support. This driver
          is responsible for handling I2C read and write on the I2C
          bus. It is also responsible for synchronization with
          GPIO and data frames.

config MSM_CSI20_HEADER
        bool "Qualcomm MSM CSI 2.0 Header"
        depends on MSMB_CAMERA
        ---help---
          Enable support for CSI drivers to include 2.0
          header. This header has register macros and its
          values and bit mask for register configuration bits
          This config macro is required targets based on 8960,
          8930 and 8064 platforms.

config MSM_CSI22_HEADER
        bool "Qualcomm MSM CSI 2.2 Header"
        depends on MSMB_CAMERA
        ---help---
          Enable support for CSI drivers to include 2.2
          header. This header has register macros and its
          values and bit mask for register configuration bits
          This config macro is required targets based on 8610
          platform.

config MSM_CSI30_HEADER
        bool "Qualcomm MSM CSI 3.0 Header"
        depends on MSMB_CAMERA
        ---help---
          Enable support for CSI drivers to include 3.0
          header. This header has register macros and its
          values and bit mask for register configuration bits
          This config macro is required for targets based on
          8064 platforms.

config MSM_CSIPHY
        bool "Qualcomm MSM Camera Serial Interface Physical receiver support"
        depends on MSMB_CAMERA
        ---help---
          Enable support for Camera Serial Interface
          Physical receiver. It deserializes packets and
          supports detection of packet start and stop
          signalling.

config MSM_CSID
        bool "Qualcomm MSM Camera Serial Interface decoder support"
        depends on MSMB_CAMERA
        ---help---
          Enable support for Camera Serial Interface decoder.
          It supports lane merging and decoding of packets
          based on cid which is mapped to a virtual channel
          and datatype.

config MSM_EEPROM
        bool "Qualcomm MSM Camera ROM Interface for Calibration support"
        depends on MSMB_CAMERA
        ---help---
          Enable support for ROM Interface for Calibration
          Provides interface for reading the Claibration data.
          and also provides support for writing data in case of FLASH ROM.
	  Currently supports I2C, CCI and SPI protocol

config MSM_ISPIF
        bool "Qualcomm MSM Image Signal Processing interface support"
        depends on MSMB_CAMERA
        ---help---
          Enable support for Image Signal Processing interface module.
          This module acts as a crossbar between CSID and VFE. Output
          of any CID of CSID can be routed to of of pixel or raw
          data interface in VFE.

config MSM_ISPIF_V1
        bool "Qualcomm MSM Image Signal Processing interface support"
        depends on MSMB_CAMERA
        ---help---
          Enable support for Image Signal Processing interface module.
          This module acts as a crossbar between CSID and VFE. Output
          of any CID of MSM_CSI22_HEADER can be routed to of pixel
          or raw data interface in VFE.

config S5K3L1YX
	bool "Sensor S5K3L1YX (BAYER 12M)"
	depends on MSMB_CAMERA
	---help---
		Samsung 12 MP Bayer Sensor with auto focus, uses
		4 mipi lanes, preview config = 1984 * 1508 at 30 fps,
		snapshot config = 4000 * 3000 at 20 fps,
		hfr video at 60, 90 and 120 fps.

config IMX219
	bool "Sensor IMX219 (BAYER 8M)"
	depends on MSMB_CAMERA
	default n
	---help---
		SONY 8 MP Bayer Sensor with auto focus, uses
		4 mipi lanes.	
		
config s5k6a1gx
	bool "Sensor s5k6a1gx (BAYER 1.3)"
	depends on MSMB_CAMERA
	default n
	---help---
		Support for s5k5e sensor driver.
		
config A116A1
	bool "Sensor s5k6a1gx (BAYER 1.3)"
	depends on MSMB_CAMERA
	default n
	---help---
		Support for 6a1 sensor driver for A11.

config GC_0339
	bool "Sensor gc0339 on A11"
	depends on MSMB_CAMERA
	default n
	---help---
		Support for gc0339 sensor driver for A11.

config MI380
	bool "Sensor MI380"
	depends on MSMB_CAMERA
	default n
	---help---
		Support for MI380 sensor driver.

config IMX135
	bool "Sensor IMX135 (BAYER 12M)"
	depends on MSMB_CAMERA
	---help---
		Sony 12 MP Bayer Sensor with auto focus, uses
		4 mipi lanes, preview config = 2104 x 1560 at 49 fps,
		snapshot config = 4208 x 3120 at 24 fps,
		Video HDR support.

config IMX134
	bool "Sensor IMX134 (BAYER 8M)"
	depends on MSMB_CAMERA
	---help---
		Sony 8 MP Bayer Sensor with auto focus, uses
		4 mipi lanes full resolution @30fps and
		HFR @60fps and @120fps
		Video HDR support.

config OV2720
	bool "Sensor OV2720 (BAYER 2M)"
	depends on MSMB_CAMERA
	---help---
		OmniVision 2 MP Bayer Sensor, supports 2 mipi lanes,
		preview and snapshot config at 1932 * 1092 at 30 fps,
		hfr video at 60, 90 and 120 fps. This sensor driver does
		not support auto focus.

config OV9724
	bool "Sensor OV9724 (BAYER 2M)"
	depends on MSMB_CAMERA
	---help---
		OmniVision 2 MP Bayer Sensor, supports 2 mipi lanes,
		preview and snapshot config at 1280*720 at 30 fps,
		hfr video at 60, 90 and 120 fps. This sensor driver does
		not support auto focus.

config HI256
        bool "Hynix hi256 (YUV 2MP)"
        depends on MSMB_CAMERA
        ---help---
                OmniVision 8 MP Bayer Sensor with auto focus.uses
                2 mipi lanes, preview config = 1632*1224 30 fps,
                snapshot config = 3264 * 2448 at 18 fps.
                2 lanes max fps is 18, 4 lanes max fps is 24.

config OV5648
	bool "Sensor OV5648 (BAYER 5M)"
	depends on MSMB_CAMERA
	---help---
		OmniVision 5 MP Bayer Sensor, only use 1 mipi lane,
		preview set to 1296*972 at 30 fps,
		snapshot set to 2592*1944 at 12 fps,
		This sensor driver does not support auto focus.

config MT9M114
	bool "Sensor MT9M114 (YUV 1.26MP)"
	depends on MSMB_CAMERA
	---help---
		MT9M114 is Aptina YUV sensor. It supports 1.26 MP preview
		and snapshot. The preview and snapshot resolution shall be
		1280 * 270. It does not support auto focus. It supports
		few special effects like saturation.

config VD6869
	bool "Sensor VD6869 (BAYER 4M)"
	depends on MSMB_CAMERA
	default n
	---help---
		ST 4MP Bayer Sensor

config OV4688
	bool "Sensor ov4688 (BAYER 4M)"
	depends on MSMB_CAMERA
	default n
	---help---
		OmniVision 4MP Bayer Sensor

config SP1628
	bool "Sensor SP1628 (YUV 720P)"
	depends on MSMB_CAMERA
	---help---
		SP1628 is SuperPix YUV sensor. It supports 720P preview
		and snapshot. The preview and snapshot resolution shall be
		1280 * 270. It does not support auto focus. It supports
		few special effects like mono.

config GC0339
	bool "Sensor GC0339 (BAYER .3M)"
	depends on MSMB_CAMERA
	---help---
		gc0339 is a Galaxycore .3 MP Bayer Sensor.
		It supports 1 or 2 mipi lanes.
		Preview and snapshot resolution shall be 640*480 at 30 fps,
		It does not support auto focus.

config OV8825
	bool "OmniVision OV8825 (BAYER 8MP)"
	depends on MSMB_CAMERA
	---help---
		OmniVision 8 MP Bayer Sensor with auto focus.uses
		2 mipi lanes, preview config = 1632*1224 30 fps,
		snapshot config = 3264 * 2448 at 18 fps.
		2 lanes max fps is 18, 4 lanes max fps is 24.

config OV8865
	bool "OmniVision OV8865 (BAYER 8MP)"
	depends on MSMB_CAMERA
	---help---
		OmniVision 8 MP Bayer Sensor with auto focus.uses
		4 mipi lanes, preview config = 1632*1224 30 fps,
		snapshot config = 3264 * 2448 at 30 fps.
		Max fps is 30fps at 3264 * 2448, 60fps at 1632 * 1224

config s5k4e1
	bool "Sensor s5k4e1 (BAYER 5MP)"
	depends on MSMB_CAMERA
	---help---
		Samsung 5 MP Bayer Sensor. It uses 2 mipi lanes,
		supports 720P preview at 30 fps
		and QSXGA snapshot at 15 fps.
		This sensor driver does not support auto focus.

config OV12830
	bool "OmniVision OV12830 (BAYER 12MP)"
	depends on MSMB_CAMERA
	---help---
		OmniVision 12.8 MP Bayer Sensor with auto focus.uses
		4 mipi lanes, preview config = 2112 * 1500 at 30 fps,
		snapshot config = 4224 * 3000 at 15 fps.
		2 lanes max fps is 18, 4 lanes max fps is 24.

config AR0260
	bool "Sensor ar0260"
	depends on MSMB_CAMERA
	default n
	---help---
	  Support for AR0260 sensor driver.

config OV13850
	bool "Sensor OV13850 (BAYER 13M)"
	depends on MSMB_CAMERA
	---help---
	  Support for ov13850 sensor driver.

config OV13850_800M
	bool "Sensor OV13850_800M (BAYER 13M)"
	depends on MSMB_CAMERA
	---help---
	  Support for ov13850_800M sensor driver.

config OV13850_1140M
	bool "Sensor OV13850_1140M (BAYER 13M)"
	depends on MSMB_CAMERA
	---help---
	  Support for ov13850_800M sensor driver.

config OV2722
	bool "Sensor ov2722"
	depends on MSMB_CAMERA
	default n
	---help---
	  Support for OV2722 sensor driver.

config S5K5E_ONELANE
	bool "Sensor S5K5E_ONELANE"
	depends on MSMB_CAMERA
	default n
	---help---
	  Support for S5K5E_ONELANE sensor driver.

config S5K5E_TWOLANE
	bool "Sensor S5K5E_TWOLANE"
	depends on MSMB_CAMERA
	default n
	---help---
	  Support for S5K5E_TWOLANE sensor driver.

config s5k5e
	bool "Sensor s5k5e"
	depends on MSMB_CAMERA
	default n
	---help---
	  Support for s5k5e sensor driver.

config MSM_V4L2_VIDEO_OVERLAY_DEVICE
	tristate "Qualcomm MSM V4l2 video overlay device"
	---help---
	  Enables support for the MSM V4L2 video
	  overlay driver. This allows video rendering
	  apps to render overlaid video using Video4Linux2
	  APIs, by using /dev/videoX device

config MSMB_JPEG
	tristate "Qualcomm MSM Jpeg Encoder Engine support"
	depends on MSMB_CAMERA && (ARCH_MSM8974 || ARCH_MSM8226)
	---help---
	  Enable support for Jpeg Encoder/Decoder
	  Engine for 8974.
	  This module serves as the common driver
	  for the JPEG 1.0 encoder and decoder.

config RAWCHIPII
        bool "RawchipII"
        depends on MSMB_CAMERA
        default n
        ---help---
          ST Yushan rawchipII

config MSM_GEMINI
	tristate "Qualcomm MSM Gemini JPEG engine support"
	depends on MSMB_CAMERA && (ARCH_MSM7X30 || ARCH_MSM8X60 || ARCH_MSM8960)
	---help---
	  Enables support for the Gemini JPEG encoder engine for 8x60.

config TI201_ACT
       bool "Lens actuator ti201"
       depends on MSMB_CAMERA
       ---help---
         ti201 lens actuator driver for SONY IMX175, IMX091 and VD6869.

config ACT_OIS_BINDER
       bool "Act_Ois_Binder"
       depends on MSMB_CAMERA
       default n
       ---help---
         Act_Ois_Binder for OIS function through ti201 lens actuator driver.

config RUMBAS_ACT
	bool "RUMBA-S actuator"
	depends on MSMB_CAMERA
	default n
	---help---
	  Autofocus of RUMBA-S actuator

config AR1820
	bool "Sensor ar1820"
	depends on MSMB_CAMERA
	default n
	---help---
	  Support for AR1820 sensor driver.

config IMX214
	bool "Sensor imx214"
	depends on MSMB_CAMERA
	default n
	---help---
	  Support for IMX214 sensor driver.

config IMX214_800M_FOV77
	bool "Sensor imx214 800M fov 77"
	depends on MSMB_CAMERA
	default n
	---help---
	  Support for IMX214 sensor driver.

config IMX214_800M_FOV87
	bool "Sensor imx214 800M fov 87"
	depends on MSMB_CAMERA
	default n
	---help---
	  Support for IMX214 sensor driver.
```

## drivers/media/video/nmi/Kconfig
```kconfig
config VIDEO_NMI
        bool "Newport Media Multimedia Devices"
        default n
        ---help---
          This is a representative video4linux configuration for Newport Media multimedia devices.

source "drivers/media/video/nmi/nmi625/Kconfig"
```

## drivers/media/video/nmi/nmi625/Kconfig
```kconfig
#
# Configuration for nmi_hw (ISDB-T)
#

config ISDBT_NMI
	bool "ISDB-T NMI Driver" 
	default y
	---help---
	  This is a ISDB-T for NMI Driver.

config ISDBT_NMI_DEBUG
	bool "print ISDB-T NMI debug message"
	depends on ISDBT_NMI
	default n
```

## drivers/media/video/panasonic/Kconfig
```kconfig
config VIDEO_PANASONIC
        bool "PANASONIC Multimedia Devices"
        default n
        ---help---
          This is a representative video4linux configuration for PANASONIC multimedia devices.

source "drivers/media/video/panasonic/mn885521/Kconfig"
```

## drivers/media/video/panasonic/mn885521/Kconfig
```kconfig
#
# Configuration for panasonic_hw (ISDB-T)
#

config ISDBT_PANASONIC
	bool "ISDB-T PANASONIC Driver" 
	default y
	---help---
	  This is a ISDB-T for PANASONIC chipset Driver.

config ISDBT_PANASONIC_DEBUG
	bool "print ISDB-T PANASONIC debug message"
	depends on ISDBT_PANASONIC
	default n
```

## drivers/staging/dev-sw-sync/Kconfig
```kconfig
# SPDX-License-Identifier: GPL-2.0-only
menu "DEV_SW_SYNC options"

config DEV_SW_SYNC
	bool "Sync File Validation Framework implemented through a Linux device"
	default n
	depends on SYNC_FILE && !SW_SYNC
	help
	  A sync object driver that uses a 32bit counter to coordinate
	  synchronization.  Useful when there is no hardware primitive backing
	  the synchronization.

	  WARNING: improper use of this can result in deadlocking kernel
	  drivers from userspace. Intended for test and debug only.

endmenu
```

## drivers/staging/htc_smem/Kconfig
```kconfig
config HTC_RADIO_SMEM
	bool "RADIO SMEM"
	default N
	---help---
	Enable to move necessary non-secure data to shared memory
```
