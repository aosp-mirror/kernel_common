/* Copyright (c) 2013, The Linux Foundation. All rights reserved.
 *
 * This program is free software; you can redistribute it and/or modify
 * it under the terms of the GNU General Public License version 2 and
 * only version 2 as published by the Free Software Foundation.
 *
 * This program is distributed in the hope that it will be useful,
 * but WITHOUT ANY WARRANTY; without even the implied warranty of
 * MERCHANTABILITY or FITNESS FOR A PARTICULAR PURPOSE.  See the
 * GNU General Public License for more details.
 */

/*---------------------------------------------------------------------------
 * This file is autogenerated file using gcdb parser. Please do not edit it.
 * Update input XML file to add a new entry or update variable in this file
 * VERSION = "1.0"
 *---------------------------------------------------------------------------*/
&soc {
	qcom,mdss_dsi_sony_nt_720p_cmd {
		compatible = "qcom,mdss-dsi-panel";
		status = "disabled";
		qcom,mdss-dsi-panel-name = "sony novatek 720p command mode dsi panel";
		qcom,mdss-dsi-panel-controller = <&mdss_dsi0>;
		qcom,mdss-dsi-panel-type = "dsi_cmd_mode";
		/*qcom,mdss-dsi-panel-type = "dsi_video_mode";*/
		qcom,mdss-dsi-panel-destination = "display_1";
		qcom,mdss-dsi-panel-framerate = <60>;
		qcom,mdss-dsi-virtual-channel-id = <0>;
		qcom,mdss-dsi-stream = <0>;
		qcom,mdss-dsi-panel-width = <720>;
		qcom,mdss-dsi-panel-height = <1280>;
		/*HTC_CSP_STAR, add Panel height/width in mm*/
		qcom,mdss-pan-physical-width-dimension = <58>;
		qcom,mdss-pan-physical-height-dimension = <103>;
		/*HTC_CSP_END*/
		qcom,mdss-dsi-h-front-porch = <95>;
		qcom,mdss-dsi-h-back-porch = <104>;
		qcom,mdss-dsi-h-pulse-width = <1>;
		qcom,mdss-dsi-h-sync-skew = <0>;
		qcom,mdss-dsi-v-back-porch = <2>;
		qcom,mdss-dsi-v-front-porch = <6>;
		qcom,mdss-dsi-v-pulse-width = <1>;
		qcom,mdss-dsi-h-left-border = <0>;
		qcom,mdss-dsi-h-right-border = <0>;
		qcom,mdss-dsi-v-top-border = <0>;
		qcom,mdss-dsi-v-bottom-border = <0>;
		qcom,mdss-dsi-bpp = <24>;
		qcom,mdss-dsi-color-order = "rgb_swap_rgb";
		qcom,mdss-dsi-underflow-color = <0xff>;
		qcom,mdss-dsi-border-color = <0>;
		qcom,mdss-dsi-on-command = [  /* set three lane */
					15 01 00 00 00 00 02 ba 02
					/* command mode */
					15 01 00 00 00 00 02 c2 08
					/* video mode */
					/*15 01 00 00 00 00 02 c2 03*/

					15 01 00 00 00 00 02 ff 00
					/* exit sleep */
					05 01 00 00 64 00 02 11 00

					/* For random dot noise */
					15 01 00 00 00 00 02 ff ee
					15 01 00 00 00 00 02 12 50
					15 01 00 00 00 00 02 13 02
					15 01 00 00 00 00 02 6a 60
					15 01 00 00 00 00 02 ff 00

					05 01 00 00 32 00 02 29 00
					/* Enable CABC setting */
					15 01 00 00 00 00 02 ff 04
					15 01 00 00 00 00 02 05 2d
					15 01 00 00 00 00 02 21 ff
					15 01 00 00 00 00 02 22 f7
					15 01 00 00 00 00 02 23 ef
					15 01 00 00 00 00 02 24 e7
					15 01 00 00 00 00 02 25 df
					15 01 00 00 00 00 02 26 d7
					15 01 00 00 00 00 02 27 cf
					15 01 00 00 00 00 02 28 c7
					15 01 00 00 00 00 02 29 bf
					15 01 00 00 00 00 02 2a b7

					15 01 00 00 00 00 02 ff 00
					/* enable te */
					15 01 00 00 00 00 02 35 00
					15 01 00 00 00 00 02 5e 06

					15 01 00 00 00 00 02 55 83
					15 01 00 00 00 00 02 53 24

					/* set backlight */
					15 01 00 00 00 00 02 51 f0];
		qcom,mdss-dsi-off-command = [05 01 00 00 32 00 02 28 00
					05 01 00 00 78 00 02 10 00];
		qcom,mdss-dsi-on-command-state = "dsi_lp_mode";
		qcom,mdss-dsi-off-command-state = "dsi_hs_mode";
		qcom,mdss-dsi-h-sync-pulse = <1>;
		qcom,mdss-dsi-traffic-mode = "burst_mode";
		qcom,mdss-dsi-lane-map = "lane_map_0123";
		qcom,mdss-dsi-bllp-eof-power-mode;
		qcom,mdss-dsi-bllp-power-mode;
		qcom,mdss-dsi-lane-0-state;
		qcom,mdss-dsi-lane-1-state;
		qcom,mdss-dsi-lane-2-state;
		/*qcom,mdss-dsi-lane-3-state;*/
		qcom,mdss-dsi-te-pin-select = <1>;
		qcom,mdss-dsi-te-v-sync-rd-ptr-irq-line = <0x2c>;
		qcom,mdss-dsi-te-dcs-command = <1>;
		qcom,mdss-dsi-te-check-enable;
		qcom,mdss-dsi-te-using-te-pin;
		qcom,mdss-dsi-panel-timings = [2b 2e 23 01 3f 40
						    25 30 3b 03 04 00];
		qcom,mdss-dsi-t-clk-post = <0x1f>;
		qcom,mdss-dsi-t-clk-pre = <0x39>;
		qcom,mdss-dsi-dma-trigger = "trigger_sw";
		qcom,mdss-dsi-mdp-trigger = "none";
		qcom,mdss-dsi-bl-pmic-control-type = "bl_ctrl_dcs";

	};
};
