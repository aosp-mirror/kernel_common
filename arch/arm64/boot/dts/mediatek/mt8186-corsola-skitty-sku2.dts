// SPDX-License-Identifier: (GPL-2.0 OR MIT)
/*
 * Copyright 2024 Google LLC
 */

/dts-v1/;
#include "mt8186-corsola-skitty.dtsi"

/ {
	model = "Google Skitty sku2 board";
	compatible = "google,skitty-sku2",
		"google,skitty", "google,corsola", "mediatek,mt8186";
};
