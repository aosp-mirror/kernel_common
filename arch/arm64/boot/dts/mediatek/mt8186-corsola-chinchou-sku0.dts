// SPDX-License-Identifier: (GPL-2.0 OR MIT)
/*
 * Copyright 2023 Google LLC
 */

/dts-v1/;
#include "mt8186-corsola-chinchou.dtsi"

/ {
	model = "Google chinchou sku0 board";
	compatible = "google,chinchou-sku0", "google,chinchou-sku2",
			"google,chinchou-sku4", "google,chinchou-sku5",
			"google,chinchou", "mediatek,mt8186";
};

&gpio_keys {
	status = "disabled";
};
