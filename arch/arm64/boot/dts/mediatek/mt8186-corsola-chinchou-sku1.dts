// SPDX-License-Identifier: (GPL-2.0 OR MIT)
/*
 * Copyright 2023 Google LLC
 */

/dts-v1/;
#include "mt8186-corsola-chinchou.dtsi"

/ {
	model = "Google chinchou sku1/sku17 board";
	compatible = "google,chinchou-sku1", "google,chinchou-sku17",
			"google,chinchou-sku3", "google,chinchou-sku6",
			"google,chinchou-sku7", "google,chinchou-sku20",
			"google,chinchou-sku22", "google,chinchou-sku23",
			"mediatek,mt8186";
};

&i2c1 {
	i2c-scl-internal-delay-ns = <10000>;

	touchscreen: touchscreen@41 {
		compatible = "ilitek,ili2901";
		reg = <0x41>;
		interrupts-extended = <&pio 12 IRQ_TYPE_LEVEL_LOW>;
		pinctrl-names = "default";
		pinctrl-0 = <&touchscreen_pins>;
		reset-gpios = <&pio 60 GPIO_ACTIVE_LOW>;
		vccio-supply = <&pp1800_tchscr_report_disable>;
	};
};

&gpio_keys {
	status = "disabled";
};
