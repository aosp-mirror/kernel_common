// SPDX-License-Identifier: (GPL-2.0 OR MIT)
/*
 * Copyright (C) 2022 MediaTek Inc.
 */
/dts-v1/;
#include "mt8195-cherry.dtsi"
#include "mt8195-dojo.dtsi"

/ {
	model = "MediaTek Dojo board";
	compatible = "google,dojo-sku5", "google,dojo-sku7",
		"google,dojo", "mediatek,mt8195";
};

&keyboard_controller {
	function-row-physmap = <
		MATRIX_KEY(0x00, 0x02, 0)	/* T1 */
		MATRIX_KEY(0x03, 0x02, 0)	/* T2 */
		MATRIX_KEY(0x02, 0x02, 0)	/* T3 */
		MATRIX_KEY(0x01, 0x02, 0)	/* T4 */
		MATRIX_KEY(0x03, 0x04, 0)	/* T5 */
		MATRIX_KEY(0x02, 0x04, 0)	/* T6 */
		MATRIX_KEY(0x01, 0x04, 0)	/* T7 */
		MATRIX_KEY(0x02, 0x09, 0)	/* T8 */
		MATRIX_KEY(0x01, 0x09, 0)	/* T9 */
		MATRIX_KEY(0x00, 0x04, 0)	/* T10 */
		MATRIX_KEY(0x00, 0x01, 0)	/* T11 */
		MATRIX_KEY(0x01, 0x05, 0)	/* T12 */
		MATRIX_KEY(0x03, 0x05, 0)	/* T13 */
	>;
	linux,keymap = <
		CROS_STD_MAIN_KEYMAP

		MATRIX_KEY(0x00, 0x02, KEY_BACK)
		MATRIX_KEY(0x03, 0x02, KEY_REFRESH)
		MATRIX_KEY(0x02, 0x02, KEY_ZOOM)
		MATRIX_KEY(0x01, 0x02, KEY_SCALE)
		MATRIX_KEY(0x03, 0x04, KEY_SYSRQ)
		MATRIX_KEY(0x02, 0x04, KEY_BRIGHTNESSDOWN)
		MATRIX_KEY(0x01, 0x04, KEY_BRIGHTNESSUP)
		MATRIX_KEY(0x02, 0x09, KEY_KBDILLUMTOGGLE)
		MATRIX_KEY(0x01, 0x09, KEY_PLAYPAUSE)
		MATRIX_KEY(0x00, 0x04, KEY_MICMUTE)
		MATRIX_KEY(0x00, 0x01, KEY_MUTE)
		MATRIX_KEY(0x01, 0x05, KEY_VOLUMEDOWN)
		MATRIX_KEY(0x03, 0x05, KEY_VOLUMEUP)

		MATRIX_KEY(0x04, 0x00, KEY_102ND)	/* override 64 KEY by 45 KEY */
	>;
};
