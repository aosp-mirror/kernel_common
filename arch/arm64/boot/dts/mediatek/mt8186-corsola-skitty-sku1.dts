// SPDX-License-Identifier: (GPL-2.0 OR MIT)
/*
 * Copyright 2024 Google LLC
 */

/dts-v1/;
#include "mt8186-corsola-skitty.dtsi"

/ {
	model = "Google Skitty sku1 board";
	compatible = "google,skitty-sku1",
		"google,skitty", "google,corsola", "mediatek,mt8186";
};

&touchscreen {
	compatible = "elan,ekth3500";
};
