// SPDX-License-Identifier: (GPL-2.0 OR MIT)
/*
 * Copyright 2024 Google LLC
 */

/dts-v1/;
#include "mt8186-corsola-kyogre.dtsi"

/ {
	model = "Google Kyogre board";
	compatible = "google,corsola", "google,kyogre", "mediatek,mt8186";
};

&mt6366codec {
	mediatek,dmic-mode = <0>; /* two-wire */
};
