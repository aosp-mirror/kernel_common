// SPDX-License-Identifier: (GPL-2.0 OR MIT)
/*
 * Copyright 2022 Google LLC
 */

/dts-v1/;
#include "mt8186-corsola-steelix.dtsi"

/ {
	model = "Google Magneton sku393218 board";
	compatible = "google,steelix-rev2-sku393218", "google,steelix-rev2", "google,steelix",
		     "mediatek,mt8186";
};

&gpio_keys {
	status = "disabled";
};

&touchscreen {
	status = "disabled";
};
