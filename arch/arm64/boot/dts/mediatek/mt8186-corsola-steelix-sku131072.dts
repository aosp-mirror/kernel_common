// SPDX-License-Identifier: (GPL-2.0 OR MIT)
/*
 * Copyright 2022 Google LLC
 */

/dts-v1/;
#include "mt8186-corsola-steelix.dtsi"

/ {
	model = "Google Steelix sku131072/131074/unprovisioned board";
	compatible = "google,steelix-sku131072", "google,steelix-sku131074",
		     "google,steelix-sku2147483647", "google,steelix",
		     "mediatek,mt8186";
};

&mt6366codec {
	mediatek,dmic-mode = <0>; /* two-wire */
};
