// SPDX-License-Identifier: (GPL-2.0 OR MIT)
/*
 * Copyright 2022 Google LLC
 */

/dts-v1/;
#include "mt8186-corsola-magikarp.dtsi"

/ {
	model = "Google Magikarp board";
	compatible = "google,magikarp-sku458752", "google,magikarp", "google,corsola",
		     "mediatek,mt8186";
};

&gpio_keys {
	status = "disabled";
};

&touchscreen {
	status = "disabled";
};
